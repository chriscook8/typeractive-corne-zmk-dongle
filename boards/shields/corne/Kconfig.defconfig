## boards/shields/corne/Kconfig.defconfig
```kconfig
# Copyright (c) 2020 Pete Johanson
# SPDX-License-Identifier: MIT

# Dongle is the central
if SHIELD_CORNE_DONGLE

config ZMK_KEYBOARD_NAME
    default "Corne"

config ZMK_SPLIT_ROLE_CENTRAL
    default y

config ZMK_SPLIT
    default y

config ZMK_SPLIT_BLE_CENTRAL_PERIPHERALS
    default 2

config BT_MAX_CONN
    default 7

config BT_MAX_PAIRED
    default 7

config ZMK_USB
    default y

config ZMK_BLE
    default y

endif

# Left half is a peripheral (NOT central)
if SHIELD_CORNE_LEFT

config ZMK_SPLIT
    default y

config ZMK_SPLIT_ROLE_CENTRAL
    default n

config ZMK_BLE
    default y

endif

# Right half is a peripheral
if SHIELD_CORNE_RIGHT

config ZMK_SPLIT
    default y

config ZMK_SPLIT_ROLE_CENTRAL
    default n

config ZMK_BLE
    default y

endif
```

## boards/shields/corne_dongle/Kconfig.defconfig
```kconfig
# Copyright (c) 2024
# SPDX-License-Identifier: MIT

if SHIELD_CORNE_DONGLE

config ZMK_KEYBOARD_NAME
    default "Corne"

config ZMK_SPLIT_ROLE_CENTRAL
    default y

config ZMK_SPLIT
    default y

# Two peripherals: left half and right half
config ZMK_SPLIT_BLE_CENTRAL_PERIPHERALS
    default 2

# Total BT connections = peripherals (2) + BT profiles (5)
config BT_MAX_CONN
    default 7

config BT_MAX_PAIRED
    default 7

# USB output for dongle
config ZMK_USB
    default y

config ZMK_BLE
    default y

endif
```

## boards/shields/corne_dongle_setup/Kconfig.defconfig
```kconfig
# Copyright (c) 2024
# SPDX-License-Identifier: MIT

# Dongle is the central
if SHIELD_CORNE_DONGLE

config ZMK_KEYBOARD_NAME
    default "Corne"

config ZMK_SPLIT_ROLE_CENTRAL
    default y

config ZMK_SPLIT
    default y

config ZMK_SPLIT_BLE_CENTRAL_PERIPHERALS
    default 2

config BT_MAX_CONN
    default 7

config BT_MAX_PAIRED
    default 7

config ZMK_USB
    default y

config ZMK_BLE
    default y

endif

# Left peripheral
if SHIELD_CORNE_PERIPHERAL_LEFT

config ZMK_SPLIT
    default y

config ZMK_SPLIT_ROLE_CENTRAL
    default n

config ZMK_BLE
    default y

endif

# Right peripheral
if SHIELD_CORNE_PERIPHERAL_RIGHT

config ZMK_SPLIT
    default y

config ZMK_SPLIT_ROLE_CENTRAL
    default n

config ZMK_BLE
    default y

endif
```
